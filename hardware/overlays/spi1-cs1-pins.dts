/dts-v1/;
/plugin/;

/ {
    compatible = "allwinner,sun50i-h618", "allwinner,sun50i-h616";

    fragment@0 {
        target = <&spi1>;

        __overlay__ {
            pinctrl-names = "default";
            pinctrl-0 = <&spi1_pins &spi1_cs1_pin>;
            status = "okay";
        };
    };
};
